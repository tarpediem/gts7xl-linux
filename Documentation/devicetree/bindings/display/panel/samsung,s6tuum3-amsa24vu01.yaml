## Documentation/devicetree/bindings/display/panel/samsung,s6tuum3-amsa24vu01.yaml
```yaml
# SPDX-License-Identifier: GPL-2.0-only OR BSD-2-Clause
%YAML 1.2
---
$id: http://devicetree.org/schemas/display/panel/samsung,s6tuum3-amsa24vu01.yaml#
$schema: http://devicetree.org/meta-schemas/core.yaml#

title: Samsung AMSA24VU01 OLED panel with S6TUUM3 DDIC

maintainers:
  - tarpediem <tarpediem@gmail.com>

description:
  2800x1752 OLED panel with a Samsung S6TUUM3 display driver IC and an
  Anapass timing controller, driven over four DSI lanes in command mode
  with Display Stream Compression. The module makes its own panel rails
  from a single supply. Found in the Samsung Galaxy Tab S7+.

allOf:
  - $ref: panel-common.yaml#

properties:
  compatible:
    const: samsung,s6tuum3-amsa24vu01

  reg:
    maxItems: 1

  vddlcd-supply:
    description: Power supply of the panel module

  reset-gpios: true

  tcon-rdy-gpios:
    maxItems: 1
    description: TCON ready output of the panel, high once the timing
      controller has started after reset

  port: true

required:
  - compatible
  - reg
  - vddlcd-supply
  - reset-gpios
  - tcon-rdy-gpios
  - port

unevaluatedProperties: false

examples:
  - |
    #include <dt-bindings/gpio/gpio.h>

    dsi {
        #address-cells = <1>;
        #size-cells = <0>;

        panel@0 {
            compatible = "samsung,s6tuum3-amsa24vu01";
            reg = <0>;

            vddlcd-supply = <&vreg_panel>;
            reset-gpios = <&tlmm 82 GPIO_ACTIVE_LOW>;
            tcon-rdy-gpios = <&tlmm 26 GPIO_ACTIVE_HIGH>;

            port {
                endpoint {
                    remote-endpoint = <&dsi0_out>;
                };
            };
        };
    };

...
```

## Documentation/devicetree/bindings/input/touchscreen/st,fts1ba90a.yaml
```yaml
# SPDX-License-Identifier: GPL-2.0-only OR BSD-2-Clause
%YAML 1.2
---
$id: http://devicetree.org/schemas/input/touchscreen/st,fts1ba90a.yaml#
$schema: http://devicetree.org/meta-schemas/core.yaml#

title: STMicroelectronics FTS1BA90A touchscreen controller

maintainers:
  - tarpediem <tarpediem@gmail.com>

description:
  FingerTip touchscreen controller of the "fts1b" generation, as found in the
  Samsung Galaxy Tab S7+. It uses another command set and event format than
  the controllers covered by st,stmfts.yaml.

allOf:
  - $ref: touchscreen.yaml#

properties:
  compatible:
    const: st,fts1ba90a

  reg:
    maxItems: 1

  interrupts:
    maxItems: 1

  avdd-supply:
    description: Analog power supply (3.3 V)

  vdd-supply:
    description: Digital power supply (1.8 V)

required:
  - compatible
  - reg
  - interrupts
  - avdd-supply
  - vdd-supply
  - touchscreen-size-x
  - touchscreen-size-y

unevaluatedProperties: false

examples:
  - |
    #include <dt-bindings/interrupt-controller/irq.h>

    i2c {
        #address-cells = <1>;
        #size-cells = <0>;

        touchscreen@49 {
            compatible = "st,fts1ba90a";
            reg = <0x49>;
            interrupt-parent = <&tlmm>;
            interrupts = <15 IRQ_TYPE_LEVEL_LOW>;
            avdd-supply = <&vreg_l13a_3p3>;
            vdd-supply = <&vreg_l14a_1p8>;
            touchscreen-size-x = <1752>;
            touchscreen-size-y = <2800>;
            touchscreen-inverted-x;
            touchscreen-swapped-x-y;
        };
    };
```

## Documentation/devicetree/bindings/power/supply/maxim,max77705.yaml
```yaml
# SPDX-License-Identifier: GPL-2.0-only OR BSD-2-Clause
%YAML 1.2
---
$id: http://devicetree.org/schemas/power/supply/maxim,max77705.yaml#
$schema: http://devicetree.org/meta-schemas/core.yaml#

title: Maxim MAX777705 charger

maintainers:
  - Dzmitry Sankouski <dsankouski@gmail.com>

description: |
  This is a device tree bindings for charger found in Maxim MAX77705 chip.

allOf:
  - $ref: power-supply.yaml#

properties:
  compatible:
    const: maxim,max77705-charger

  interrupts:
    maxItems: 1

  reg:
    maxItems: 1

  io-channels:
    maxItems: 1
    description:
      Battery thermistor. When given, the driver enables charging only while
      the temperature is inside the alert-celsius range of the monitored
      battery (2 C hysteresis), runs the safety timer and keeps the charger
      watchdog enabled and kicked.

  io-channel-names:
    const: battery-temp

  input-current-limit-microamp:
    description: Upper limit of the CHGIN input current.

  maxim,dcp-input-current-limit-microamp:
    description:
      With the battery thermistor, input limit used only while the USB-C
      block's BC1.2 detection reports a dedicated charging port (DCP);
      every other cable, or an unreadable status, gets
      input-current-limit-microamp.

  maxim,typec-1500ma-input-current-limit-microamp:
    description:
      With the battery thermistor and DCP detection, input limit used while
      the USB-C block reports the tablet as the sink of a source advertising
      1.5 A (Type-C Rp); the larger of this and the BC1.2 value applies.
    maximum: 1400000

  maxim,typec-3000ma-input-current-limit-microamp:
    description:
      As maxim,typec-1500ma-input-current-limit-microamp, for a source
      advertising 3.0 A.
    maximum: 3000000

  usb-role-switch:
    $ref: /schemas/types.yaml#/definitions/phandle
    description:
      USB role switch (the USB controller) to set from the USB-C block's
      attach state: host while a sink is attached, device otherwise. With
      it, the charger can also supply VBUS (OTG boost, 900 mA) to an
      attached sink, off until enabled from userspace.

  maxim,otg-min-capacity-percent:
    description:
      No VBUS output below this battery capacity.
    minimum: 5
    maximum: 100
    default: 15

  maxim,dcp-constant-charge-current-microamp:
    description:
      With the battery thermistor and DCP detection, charge current used
      only while a dedicated charging port is detected; every other cable,
      or an unreadable status, gets the battery's
      constant-charge-current-max-microamp.
    maximum: 1500000

  maxim,safety-timer-sec:
    description:
      With the battery thermistor, stop charging after this much charging
      time since the input was plugged in. 0 or absent disables the timer.

dependencies:
  io-channel-names: [ io-channels ]
  maxim,safety-timer-sec: [ io-channels ]
  maxim,dcp-input-current-limit-microamp: [ io-channels, input-current-limit-microamp ]
  maxim,dcp-constant-charge-current-microamp: [ maxim,dcp-input-current-limit-microamp ]
  maxim,typec-1500ma-input-current-limit-microamp: [ maxim,dcp-input-current-limit-microamp ]
  maxim,typec-3000ma-input-current-limit-microamp: [ maxim,dcp-input-current-limit-microamp ]
  usb-role-switch: [ maxim,dcp-input-current-limit-microamp ]
  maxim,otg-min-capacity-percent: [ usb-role-switch ]

required:
  - compatible
  - reg
  - monitored-battery

unevaluatedProperties: false

examples:
  - |
    #include <dt-bindings/interrupt-controller/irq.h>

    i2c {
        #address-cells = <1>;
        #size-cells = <0>;

        charger@69 {
            compatible = "maxim,max77705-charger";
            reg = <0x69>;
            monitored-battery = <&battery>;
            interrupt-parent = <&pm8998_gpios>;
            interrupts = <11 IRQ_TYPE_LEVEL_LOW>;
        };
    };
```
